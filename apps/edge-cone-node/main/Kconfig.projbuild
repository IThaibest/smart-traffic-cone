## apps/edge-cone-node/main/Kconfig.projbuild
```kconfig
menu "Smart Traffic Cone Node"

config CONE_NODE_ID
    string "Cone node id"
    default "cone-demo-001"
    help
        Stable id used in telemetry and cloud device records.

config CONE_NODE_TELEMETRY_INTERVAL_MS
    int "Telemetry upload interval in milliseconds"
    default 3000
    range 500 60000
    help
        Product-level interval for building and sending telemetry snapshots.

endmenu
```

## apps/edge-cone-node/sdkconfig.defaults
```kconfig
CONFIG_CONE_DEVICE_ENABLE_GPS=y
CONFIG_CONE_DEVICE_ENABLE_ULTRASONIC_ARRAY=y
CONFIG_CONE_DEVICE_ENABLE_CAMERA=y
CONFIG_CONE_NODE_ID="cone-demo-001"
CONFIG_CONE_NODE_TELEMETRY_INTERVAL_MS=3000
```

## components/cone_device/Kconfig
```kconfig
menu "Cone device modules"

config CONE_DEVICE_ENABLE_GPS
    bool "Enable GPS module"
    default n
    help
        Build the generic GPS positioning module interface.

config CONE_DEVICE_ENABLE_ULTRASONIC_ARRAY
    bool "Enable four-channel ultrasonic array"
    default n
    help
        Build the generic four-channel ultrasonic distance module interface.

config CONE_DEVICE_ENABLE_CAMERA
    bool "Enable camera module"
    default n
    help
        Build the generic camera status and capture module interface.

endmenu
```
